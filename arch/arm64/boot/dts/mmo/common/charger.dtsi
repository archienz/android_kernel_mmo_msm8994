/* Copyright (c) 2014-2015, The Linux Foundation. All rights reserved.
 *
 * This program is free software; you can redistribute it and/or modify
 * it under the terms of the GNU General Public License version 2 and
 * only version 2 as published by the Free Software Foundation.
 *
 * This program is distributed in the hope that it will be useful,
 * but WITHOUT ANY WARRANTY; without even the implied warranty of
 * MERCHANTABILITY or FITNESS FOR A PARTICULAR PURPOSE.  See the
 * GNU General Public License for more details.
 */

 &pmi8994_fg {
	status = "ok";
	qcom,hold-soc-while-full;
	qcom,charger = <&pmi8994_charger>;
	/* WOA QcBattMngr LowBatteryVoltage is 3500 mV. */
	qcom,fg-vbatt-low-threshold = <3500>;
	qcom,resume-soc = <99>;
	qcom,resume-soc-raw = <253>;
	qcom,fg-iterm-ma = <200>;
	qcom,fg-chg-iterm-ma = <100>;
	/* Keep the FG above the Microsoft 3200 mV empty cutoff. */
	qcom,fg-cutoff-voltage-mv = <3200>;
	qcom,warm-bat-decidegc = <450>;
	qcom,hot-bat-decidegc = <550>;
	qcom,cool-bat-decidegc = <(-50)>;
	qcom,cold-bat-decidegc = <(-100)>;
	qcom,vbat-estimate-diff-mv = <200>;
	qcom,thermal-coefficients = [EC 85 76 4A FC 35];
};

&pmi8994_charger {
	status = "ok";
	qcom,charge-unknown-battery;
	qcom,iterm-ma = <100>;
	qcom,float-voltage-comp = <13>; /* 4.1V */
	qcom,fastchg-current-comp = <500>; /* 500mA */
	qcom,fastchg-current-ma = <2600>; 
	qcom,fastchg-down-current-ma = <1800>; 
	qcom,float-voltage-mv = <4350>; 
	qcom,resume-delta-mv = <200>; 
	/*
	 * Measured 2026-09-05: on a 500 mA SDP with the screen on the pack
	 * never reaches termination inside 768 min, the PMI8994 safety timer
	 * fires (MISC RT_STS bit 2) and hardware latches charging off until
	 * VBUS is physically removed. Toggling EN_BAT_CHG, USB suspend or
	 * SFT_CFG does not clear the latch. 0 sets SFT_TIMER_DISABLE_BIT;
	 * termination stays on iterm-ma plus the fuel gauge.
	 */
	qcom,charging-timeout-mins = <0>;
	qcom,parallel-usb-min-current-ma = <700>; 
	qcom,parallel-allowed-lowering-ma = <3000>; 
	qcom,chg-vadc = <&pmi8994_vadc>;
	qcom,dc-psy-type = "Wireless";
	qcom,dc-psy-ma = <900>;
	/* Schematic TYPE_C CC into PMI8994. PD_EN exists as a net; no PD PHY. */
	qcom,usb-cc-controller;
	qcom,disable-apsd;
	qcom,disable-hvdcp;
	qcom,customized-jeita;
	/delete-property/ qcom,thermal-mitigation;
	qcom,ibat-thermal-mitigation = <1400 1200 600 1200 300 1200 100 600 0 0>;
};

